# cross_trigger_matrix: IP-XACT component
VLNV tenstorrent.com:ocah:cross_trigger_matrix:1.0

## Address spaces and blocks
cross_trigger_matrix_mmap.cross_trigger_matrix: base 'h0, range 'hd0, width 32

## Registers
Registers are 32-bit, read-write, reset 0x0 unless marked. A register's access mark holds for its fields unless they carry their own. Offsets are from the block's base; lines under a group give offsets from that group; [hi:lo] are bit positions; {n}, {i} and the like mark numbered series; 'fields as' and 'values as' point back to an identical list; <NAME> marks a mode.

## cross_trigger_matrix_mmap.cross_trigger_matrix — Configuration registers for the cross trigger matrix
Base 0x00000000
{0x0+8i} CT_SRC[{i}] (i=0..25) group — Cross trigger destination selection for one CT_Src output port
  0x00 CONFIG_0 — Cross Trigger Source Configuration - CT_Dst select mask
    [25:0] CT_DST_SELECT — Selects the CT_Dst port(s) to forward on the CT_Src output at this array index. Each bit corresponds to one CT_Dst port, from CT_Dst[0] at bit 0 upwards. Multiple ports may be selected as a trigger source. All selected source ports are then OR'd together to produce the CT_Src output. Set this register to all-zero to disable that output.

## Notices in the file
SPDX-License-Identifier: Apache-2.0
SPDX-FileCopyrightText: 2026 Tenstorrent USA, Inc.
