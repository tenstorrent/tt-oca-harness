# uart_log_engine_ctrl: IP-XACT component
VLNV tenstorrent.com:ocah:uart_log_engine_ctrl:1.0

## Address spaces and blocks
uart_log_engine_ctrl_mmap.uart_log_engine_ctrl: base 'h0, range 'h4, width 32

## Registers
Registers are 32-bit, read-write, reset 0x0 unless marked. A register's access mark holds for its fields unless they carry their own. Offsets are from the block's base; lines under a group give offsets from that group; [hi:lo] are bit positions; {n}, {i} and the like mark numbered series; 'fields as' and 'values as' point back to an identical list; <NAME> marks a mode.

## uart_log_engine_ctrl_mmap.uart_log_engine_ctrl — Top-level enable register for the UART log-engine block.
Base 0x00000000
0x00 CTRL — Control Register
  [0] UART_EN — UART Enable. The hardware LSIO request of the UART's RX, TX, RTS and CTS pads: while set, the UART owns their data and direction. While clear, the UART keeps running, but its pads follow the GPIO data and direction selection like any pad without a hardware request, so TX and RTS do not reach the pins unless software forces LSIO selection. Without that selection, the receive and CTS inputs read high, the serial idle level: the receiver sees no start bit and `MSR.CTS` reads 0.

## Notices in the file
SPDX-License-Identifier: Apache-2.0
SPDX-FileCopyrightText: 2026 Tenstorrent USA, Inc.
