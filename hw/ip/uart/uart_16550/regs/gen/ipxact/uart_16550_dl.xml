# uart_16550_dl: IP-XACT component
VLNV tenstorrent.com:ocah:uart_16550_dl:1.0

## Address spaces and blocks
uart_16550_dl_mmap.uart_16550_dl: base 'h0, range 'h8, width 32

## Registers
Registers are 32-bit, read-write, reset 0x0 unless marked. A register's access mark holds for its fields unless they carry their own. Offsets are from the block's base; lines under a group give offsets from that group; [hi:lo] are bit positions; {n}, {i} and the like mark numbered series; 'fields as' and 'values as' point back to an identical list; <NAME> marks a mode.

## uart_16550_dl_mmap.uart_16550_dl — Contains the registers accessible only when `LCR.DLAB = 1`.
Base 0x00000000
0x00 DLL — Divisor Latch Least Significant Byte Register
  [7:0] DLL — Divisor Latch Least Significant Byte. Baud rate is calculated as `baud_rate = system_clock_frequency / (16 * (divisor + 1))`. When the divisor is set to `0`, the transmitter and receiver logic are disabled.
0x04 DLM — Divisor Latch Most Significant Byte Register
  [7:0] DLM — Divisor Latch Most Significant Byte. Baud rate is calculated as `baud_rate = system_clock_frequency / (16 * (divisor + 1))`. When the divisor is set to `0`, the transmitter and receiver logic are disabled.

## Notices in the file
SPDX-License-Identifier: Apache-2.0
SPDX-FileCopyrightText: 2026 Tenstorrent USA, Inc.
