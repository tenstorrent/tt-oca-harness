# pwm_ctrl: IP-XACT component
VLNV tenstorrent.com:ocah:pwm_ctrl:1.0

## Address spaces and blocks
pwm_ctrl_mmap.pwm_ctrl: base 'h0, range 'h4, width 32

## Registers
Registers are 32-bit, read-write, reset 0x0 unless marked. A register's access mark holds for its fields unless they carry their own. Offsets are from the block's base; lines under a group give offsets from that group; [hi:lo] are bit positions; {n}, {i} and the like mark numbered series; 'fields as' and 'values as' point back to an identical list; <NAME> marks a mode.

## pwm_ctrl_mmap.pwm_ctrl — Per-channel pad-function select for the PWM outputs.
Base 0x00000000
0x00 CTRL — Control Register
  [3:0] PAD_EN — PWM Pad Function Select, one bit per channel. When bit i is set, the integration routes channel i's output to its pad. Does not start the channel; PWM_EN starts and stops each channel's waveform.

## Notices in the file
SPDX-License-Identifier: Apache-2.0
SPDX-FileCopyrightText: 2026 Tenstorrent USA, Inc.
