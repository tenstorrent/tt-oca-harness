# abr_wrapper_key: IP-XACT component
VLNV tenstorrent.com:ocah:abr_wrapper_key:1.0

## Address spaces and blocks
abr_wrapper_key_mmap.abr_wrapper_key: base 'h0, range 'h42c, width 32

## Registers
Registers are 32-bit, write-only, no defined reset value unless marked. A register's access mark holds for its fields unless they carry their own. Offsets are from the block's base; lines under a group give offsets from that group; [hi:lo] are bit positions; {n}, {i} and the like mark numbered series; 'fields as' and 'values as' point back to an identical list; <NAME> marks a mode.

## abr_wrapper_key_mmap.abr_wrapper_key — Single AXI4-Lite window for all KM sideload interfaces to Adams Bridge. Contains four dual-share secret-seed inputs and one shared-key output.
Base 0x00000000
0x00 MLDSA_SEED group — Dual-share 256-bit secret seed (write-only) + key_valid flag. Layout identical to aes_wrapper_key for firmware reuse.
  {0x0+4j} KEY_SHARE0[{j}] (j=0..7) — One 32-bit word of key data. Write-only; reads return 0. No reset; powers up with undefined value.
    [31:0] data — 32-bit key data word. Write-only for security.
  {0x20+4j} KEY_SHARE1[{j}] (j=0..7) — One 32-bit word of key data. Write-only; reads return 0. No reset; powers up with undefined value.
    [31:0] data — 32-bit key data word. Write-only for security.
  0x40 KEY_CTRL access per field reset 0x0 — Seed control register. Writing KEY_VALID=1 marks the seed as loaded. Write 0 to invalidate. The KV shim gates the AB kv_read response on this bit.
    [0] key_valid rw — When 1, the seed is loaded and the KV shim will serve it to Adams Bridge. Write 0 to invalidate and allow a new seed to be written.
0x100 MLKEM_SEED_D group — Dual-share 256-bit secret seed (write-only) + key_valid flag. Layout identical to aes_wrapper_key for firmware reuse.
  {0x0+4j} KEY_SHARE0[{j}] (j=0..7) — One 32-bit word of key data. Write-only; reads return 0. No reset; powers up with undefined value.
    [31:0] data — 32-bit key data word. Write-only for security.
  {0x20+4j} KEY_SHARE1[{j}] (j=0..7) — One 32-bit word of key data. Write-only; reads return 0. No reset; powers up with undefined value.
    [31:0] data — 32-bit key data word. Write-only for security.
  0x40 KEY_CTRL access per field reset 0x0 — Seed control register. Writing KEY_VALID=1 marks the seed as loaded. Write 0 to invalidate. The KV shim gates the AB kv_read response on this bit.
    fields as MLDSA_SEED.KEY_CTRL
0x200 MLKEM_SEED_Z group — Dual-share 256-bit secret seed (write-only) + key_valid flag. Layout identical to aes_wrapper_key for firmware reuse.
  {0x0+4j} KEY_SHARE0[{j}] (j=0..7) — One 32-bit word of key data. Write-only; reads return 0. No reset; powers up with undefined value.
    [31:0] data — 32-bit key data word. Write-only for security.
  {0x20+4j} KEY_SHARE1[{j}] (j=0..7) — One 32-bit word of key data. Write-only; reads return 0. No reset; powers up with undefined value.
    [31:0] data — 32-bit key data word. Write-only for security.
  0x40 KEY_CTRL access per field reset 0x0 — Seed control register. Writing KEY_VALID=1 marks the seed as loaded. Write 0 to invalidate. The KV shim gates the AB kv_read response on this bit.
    fields as MLDSA_SEED.KEY_CTRL
0x300 MLKEM_MSG group — Dual-share 256-bit secret seed (write-only) + key_valid flag. Layout identical to aes_wrapper_key for firmware reuse.
  {0x0+4j} KEY_SHARE0[{j}] (j=0..7) — One 32-bit word of key data. Write-only; reads return 0. No reset; powers up with undefined value.
    [31:0] data — 32-bit key data word. Write-only for security.
  {0x20+4j} KEY_SHARE1[{j}] (j=0..7) — One 32-bit word of key data. Write-only; reads return 0. No reset; powers up with undefined value.
    [31:0] data — 32-bit key data word. Write-only for security.
  0x40 KEY_CTRL access per field reset 0x0 — Seed control register. Writing KEY_VALID=1 marks the seed as loaded. Write 0 to invalidate. The KV shim gates the AB kv_read response on this bit.
    fields as MLDSA_SEED.KEY_CTRL
0x400 MLKEM_SHARED_KEY group — 256-bit ML-KEM shared key output from Adams Bridge. Hardware writes KEY[*] and sets KEY_CTRL.KEY_VALID when ready. Firmware reads KEY[*] then writes KEY_CTRL=0 to consume/zeroize. IRQ_STATUS is a sticky W1C bit set by hardware on the key-ready event; the masked CPU interrupt is IRQ_STATUS & IRQ_ENABLE.
  {0x0+4j} KEY[{j}] (j=0..7) ro reset 0x0 — One 32-bit word of ML-KEM shared key output. Written by hardware when key is ready; read by KM firmware to consume. Hardware clears all words to 0 when KEY_CTRL.KEY_VALID is cleared (via hwclr).
    [31:0] data — 32-bit shared-key word. Hardware writes on key-ready event; hardware clears to 0 on key-consume event (KEY_VALID cleared).
  0x20 KEY_CTRL access per field reset 0x0 — Shared-key control. HW sets KEY_VALID when a new key is ready. Firmware writes 0 to clear (consume and zeroize).
    [0] key_valid rw write-0-clears — 1 = shared key is valid and ready for firmware consumption. Hardware sets this bit on key-ready event. Write 0 to clear; write 1 has no effect (software cannot set this bit).
  0x24 IRQ_STATUS access per field reset 0x0 — Interrupt status for ML-KEM shared key. Sticky bit set by hardware when a new shared key becomes valid; cleared by writing 1.
    [0] key_valid rw write-1-clears — ML-KEM shared key valid. Sticky, write 1 to clear.
  0x28 IRQ_ENABLE access per field reset 0x0 — Interrupt enable for ML-KEM shared key. Mask for the PicoRV32 IRQ vector bit driven by the shared-key-valid event.
    [0] key_valid_en rw — 1 = enable PicoRV32 IRQ when ML-KEM shared key is valid. 0 = mask the interrupt (KEY_CTRL.KEY_VALID can still be polled).

## Notices in the file
SPDX-License-Identifier: Apache-2.0
SPDX-FileCopyrightText: 2026 Tenstorrent USA, Inc.
