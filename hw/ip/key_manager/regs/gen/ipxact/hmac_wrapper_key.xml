# hmac_wrapper_key: IP-XACT component
VLNV tenstorrent.com:ocah:hmac_wrapper_key:1.0

## Address spaces and blocks
hmac_wrapper_key_mmap.hmac_wrapper_key: base 'h0, range 'h44, width 32

## Registers
Registers are 32-bit, write-only, no defined reset value unless marked. A register's access mark holds for its fields unless they carry their own. Offsets are from the block's base; lines under a group give offsets from that group; [hi:lo] are bit positions; {n}, {i} and the like mark numbered series; 'fields as' and 'values as' point back to an identical list; <NAME> marks a mode.

## hmac_wrapper_key_mmap.hmac_wrapper_key — Key storage registers for the HMAC sideload interface. Written by Key Manager CPU, drives keymgr_key_i on the OT HMAC core.
Base 0x00000000
{0x0+4i} KEY_SHARE0[{i}] (i=0..7) — One 32-bit word of key data. Write-only; reads return 0. No reset; powers up with undefined value.
  [31:0] data — 32-bit key data word. Write-only for security.
{0x20+4i} KEY_SHARE1[{i}] (i=0..7) — One 32-bit word of key data. Write-only; reads return 0. No reset; powers up with undefined value.
  [31:0] data — 32-bit key data word. Write-only for security.
0x40 KEY_CTRL access per field reset 0x0 — Key control register. Writing KEY_VALID=1 asserts the sideload valid signal to the HMAC core.
  [0] key_valid rw — When 1, asserts keymgr_key_i.valid to indicate key is loaded. Write 0 to invalidate the current key.

## Notices in the file
SPDX-License-Identifier: Apache-2.0
SPDX-FileCopyrightText: 2026 Tenstorrent USA, Inc.
