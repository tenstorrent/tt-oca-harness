# efuse_bank: IP-XACT component
VLNV tenstorrent.com:ocah:efuse_bank:1.0

## Address spaces and blocks
efuse_bank_mmap.efuse_bank: base 'h0, range 'h1000, width 32

## Registers
Registers are 32-bit, read-write, no defined reset value unless marked. A register's access mark holds for its fields unless they carry their own. Offsets are from the block's base; lines under a group give offsets from that group; [hi:lo] are bit positions; {n}, {i} and the like mark numbered series; 'fields as' and 'values as' point back to an identical list; <NAME> marks a mode.

## efuse_bank_mmap.efuse_bank
Base 0x00000000
{0x0+4i} EFUSE_BANK_REG[{i}] (i=0..1023) — eFuse bank storage word. Models a single 32-bit OTP word in the reference bank model, using write-one-to-set semantics to emulate set-once OTP behavior.
  [31:0] dout write-1-sets — Read Data from eFuse

## Notices in the file
SPDX-License-Identifier: Apache-2.0
SPDX-FileCopyrightText: 2026 Tenstorrent USA, Inc.
