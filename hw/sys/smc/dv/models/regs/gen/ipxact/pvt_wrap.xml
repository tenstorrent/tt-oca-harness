# pvt_wrap: IP-XACT component
VLNV tenstorrent.com:ocah:pvt_wrap:1.0

## Address spaces and blocks
pvt_wrap.footprint: base 'h0, range 'h948, width 32, memory

## Registers
Registers are 32-bit, read-write, no defined reset value unless marked. A register's access mark holds for its fields unless they carry their own. Offsets are from the block's base; lines under a group give offsets from that group; [hi:lo] are bit positions; {n}, {i} and the like mark numbered series; 'fields as' and 'values as' point back to an identical list; <NAME> marks a mode.

## pvt_wrap.footprint — Placeholder footprint (adopter PVT/monitor block; no CSRs modeled)
Base 0x00000000
{0x0+4i} mem_array[{i}] (i=0..593)
  [31:0] data ro

## Notices in the file
SPDX-License-Identifier: Apache-2.0
SPDX-FileCopyrightText: 2026 Tenstorrent USA, Inc.
