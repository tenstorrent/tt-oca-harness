# sep_external: IP-XACT component
VLNV tenstorrent.com:ocah:sep_external:1.0

## Address spaces and blocks
sep_external.efuse_shim_ctrl: base 'h0, range 'h4, width 32
sep_external.xip_region: base 'h10000000, range 'h10000000, width 64, memory

## Registers
Registers are 32-bit, read-write, reset 0x20 unless marked. A register's access mark holds for its fields unless they carry their own. Offsets are from the block's base; lines under a group give offsets from that group; [hi:lo] are bit positions; {n}, {i} and the like mark numbered series; 'fields as' and 'values as' point back to an identical list; <NAME> marks a mode.

## sep_external.efuse_shim_ctrl — DV model of the eFuse SHIM control interface.
Base 0x00000000
0x00 EFUSE_BANK_INIT_TIME — eFuse bank initialization time. Number of cycles to wait for the OTP macro to initialize before sensing can begin.
  [31:0] init_time — Most OTP have a initialization time before sensing can be done

## Notices in the file
SPDX-License-Identifier: Apache-2.0
SPDX-FileCopyrightText: 2026 Tenstorrent USA, Inc.
